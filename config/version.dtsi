#define VERSION_MACRO
macro_ver: macro_ver {
compatible = "zmk,behavior-macro";
label = "macro_ver";
#binding-cells = <0>;
bindings = <&kp N2>, <&kp N0>, <&kp N2>, <&kp N4>, <&kp N1>, <&kp N1>, <&kp N2>, <&kp N6>, <&kp MINUS>, <&kp H>, <&kp O>, <&kp M>, <&kp E>, <&kp MINUS>, <&kp F>, <&kp F>, <&kp E>, <&kp B>, <&kp N2>, <&kp N3>, <&kp N1>, <&kp RET>;
};
